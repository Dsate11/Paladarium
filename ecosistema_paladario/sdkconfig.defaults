## ecosistema_paladario/sdkconfig.defaults
```kconfig
# UART Console Configuration
CONFIG_ESP_CONSOLE_UART_BAUDRATE=115200

# mDNS Configuration
CONFIG_MDNS_MAX_SERVICES=10
CONFIG_MDNS_TASK_PRIORITY=1
CONFIG_MDNS_TASK_STACK_SIZE=4096
CONFIG_MDNS_TASK_AFFINITY_CPU0=y
CONFIG_MDNS_SERVICE_ADD_TIMEOUT_MS=2000
CONFIG_MDNS_TIMER_PERIOD_MS=100
CONFIG_MDNS_NETWORKING_SOCKET=y
```
